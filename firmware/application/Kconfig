## firmware/application/Kconfig
```kconfig
mainmenu "Chip Remote Firmware"

menu "Firmware Specific Build Configuration"

choice CR_INTERFACE_TYPE
       prompt "Control Interface Type"
       default CR_INTERFACE_NONE

config CR_INTERFACE_SIMPLE_SERIAL
       bool "Simple Serial Interface"
       help
         This is the right choice for serial interfaces such as UART.

config CR_INTERFACE_SMART_SERIAL
       bool "Smart Serial Interface"
       help
         This is for serial interfaces such as USB CDC ACM for native
         POSIX build serial ports.

config CR_INTERFACE_TCPIP
       bool "Networking interface using TCP/IP"

config CR_INTERFACE_NONE
       bool "None (Default, but invalid - see help)"
       help
         Every board port must specify this type in their board specific
         configuration file.

endchoice # CR_INTERFACE_TYPE

config CR_PROTOCOL_SERIAL_BAUDRATE
       int "Serial Port Symbolrate"
       depends on CR_INTERFACE_SIMPLE_SERIAL
       default 921600
       help
         Configure the symbolrate used by the chip-remote control interface
         running on a simple serial port. Note that oftentimes serial ports
         only support a fixed set of symbolrates. Most serial ports support:
         50, 75, 110, 134, 150, 200, 300, 600, 1200, 1800, 2400, 4800, 9600,
         19200, 38400, 57600, 115200, 230400, 460800, 500000, 576000, 921600.
         Some ports also support: 1000000, 1152000, 1500000, 2000000, 2500000,
         3000000, 3500000, 4000000.

config CR_MAX_I2C_SECTIONS
    int "Maximum number of sections in an I2C message"
    default 8

endmenu

# This is from zephyr-3.0.0, but without the (toolchain = zephyr) check. I
# think this is a bug in zephyr. The intend from the comment in 0e0f878ddc
# seems to be to avoid trying to use picolibc with clang, and to only enable
# support for GNU based toolchains. "gnuarmemb" is one of those however. So
# that check is too restrictive. Luckily it is possible to override this be-
# haviour in the application's Kconfig file. That's what we'll do for now.
config PICOLIBC_SUPPORTED
    bool
    depends on !NATIVE_APPLICATION
    depends on !(CPP && "$(ZEPHYR_TOOLCHAIN_VARIANT)" = "zephyr")
    default y

source "Kconfig.zephyr"
```

## firmware/application/boards/nucleo_f767zi.conf
```kconfig
# Default to performance optimsation by default. This MCU has plenty of RAM and
# FLASH memory.
CONFIG_SPEED_OPTIMIZATIONS=y

# Enable CDC-ACM for USB based serial communication.
CONFIG_HWINFO=y
CONFIG_HWINFO_STM32=y
CONFIG_USB_DC_STM32=y
CONFIG_USB_MAX_POWER=150
CONFIG_USB_DEVICE_DRIVER=y
CONFIG_USB_DEVICE_STACK=y
CONFIG_SERIAL=y
CONFIG_USB_CDC_ACM=y
CONFIG_USB_COMPOSITE_DEVICE=y
CONFIG_UART_INTERRUPT_DRIVEN=y
CONFIG_USB_DEVICE_VID=0x1234
CONFIG_USB_DEVICE_PID=0xfedc
CONFIG_USB_DEVICE_MANUFACTURER="ChipRemote"
CONFIG_USB_DEVICE_PRODUCT="ChipRemoteBridge"
CONFIG_USB_DEVICE_SN="1122334455667788"

# We're using a couple of things that zephyr's minimal libc does not provide.
# Like isdigit(). Picolibc builds from source as a zephyr module, newlib
# currently does not. Debian's newlibe package does not set the compile time
# options required for zephyr 3.2.
CONFIG_PICOLIBC=y
CONFIG_PICOLIBC_USE_MODULE=y
```

## firmware/application/boards/nucleo_l476rg.conf
```kconfig
CONFIG_SPI=y
CONFIG_I2C=y
CONFIG_UART_INTERRUPT_DRIVEN=y
CONFIG_HWINFO=y
CONFIG_HWINFO_STM32=y

# We're using a couple of things that zephyr's minimal libc does not provide.
# Like isdigit(). Picolibc builds from source as a zephyr module, newlib
# currently does not. Debian's newlibe package does not set the compile time
# options required for zephyr 3.2.
CONFIG_PICOLIBC=y
CONFIG_PICOLIBC_MODULE=y

CONFIG_CR_INTERFACE_SIMPLE_SERIAL=y
CONFIG_CR_PROTOCOL_SERIAL_BAUDRATE=921600
CONFIG_UFW_ENDPOINT_UART_FIFO=y
CONFIG_UFW_ENDPOINT_UART_POLL=y
```

## firmware/src/Kconfig
```kconfig
mainmenu "Chip Remote Firmware"

menu "Firmware Specific Build Configuration"

menu "Chip Remote Control Interface"

choice CR_INTERFACE_TYPE
	prompt "Control Interface Type"
	default CR_INTERFACE_NONE

config CR_INTERFACE_SERIAL_FIFO
	bool "Simple Serial Interface"
	depends on UFW_ENDPOINT_UART_FIFO
	help
	  This is the right choice for almost all serial interfaces.

config CR_INTERFACE_SERIAL_POLL
	bool "Serial processing using polling operation"
	depends on UFW_ENDPOINT_UART_POLL
	help
	  This is for serial interfaces that do not allow using the interrupt
	  based FIFO approach of CR_INTERFACE_SERIAL_FIFO, such as the serial
	  ports of the native simulator port.

config CR_INTERFACE_TCPIP
	bool "Networking interface using TCP/IP"
	depends on NET_TCP

config CR_INTERFACE_NONE
	bool "None (Default, but invalid - see help)"
	help
	  Every board port must specify this type in their board specific
	  configuration file.

endchoice # CR_INTERFACE_TYPE

config CR_WITH_SERIAL
	bool
	default (CR_INTERFACE_SERIAL_POLL || CR_INTERFACE_SERIAL_FIFO)

config CR_WITH_SERIAL_BAUDRATE
	bool "Set a specific baud-rate for the chip-remote interface"
	depends on CR_WITH_SERIAL
	default n

config CR_PROTOCOL_SERIAL_BAUDRATE
	int "Serial Port Symbolrate"
	depends on CR_WITH_SERIAL_BAUDRATE
	default 9600
	help
	  Configure the symbolrate used by the chip-remote control interface
	  running on a simple serial port. Note that oftentimes serial ports
	  only support a fixed set of symbolrates. Most serial ports support:
	  50, 75, 110, 134, 150, 200, 300, 600, 1200, 1800, 2400, 4800, 9600,
	  19200, 38400, 57600, 115200, 230400, 460800, 500000, 576000, 921600.
	  Some ports also support: 1000000, 1152000, 1500000, 2000000, 2500000,
	  3000000, 3500000, 4000000.

config CR_PROTOCOL_TCP_PORT
	int "TCP port name for use by control interface"
	default 1234
	depends on CR_INTERFACE_TCPIP

endmenu # Chip Remote Control Interface

menuconfig INSTRUMENTATION_INTERFACE
	bool "Firmware Intrumentation Interface"
	depends on NET_TCP
	help
	  This is only really useful with testing firmwares, that are built
	  for native-sim, for automatic system tests. The interface allows
	  the user to specify the behaviour of the system at runtime.

if INSTRUMENTATION_INTERFACE

config CR_II_TCP_PORT
	int "TCP Port to run the instrumentation interface on"
	default 12345

endif # INSTRUMENTATION_INTERFACE

config CR_MAX_I2C_SECTIONS
	int "Maximum number of sections in an I2C message"
	default 8
	help
	  In I2C messages, it is possible to have multiple sections of byte
	  read and write sections. This is the maximum that is possible to
	  use with chip-remote's control interface. The higher the number,
	  the more stack space some ofthe I2C processing requires.

endmenu # Firmware Specific Build Configuration

# This is from zephyr-3.5.0, but adding the || (ZEPHYR_PICOLIBC_MODULE). I
# think this is a bug in zephyr. This allows us to use picolibc form a module
# without patching the kernel. That's what we'll do for now. I should probably
# see if this can be fixed upstream.
config PICOLIBC_SUPPORTED
	bool
	depends on !NATIVE_APPLICATION
	depends on ("$(TOOLCHAIN_HAS_PICOLIBC)" = "y") || (NATIVE_LIBRARY) || (ZEPHYR_PICOLIBC_MODULE)
	depends on !REQUIRES_FULL_LIBCPP || ("$(TOOLCHAIN_HAS_PICOLIBC)" = "y")
	default y
	select FULL_LIBC_SUPPORTED
	help
	  Selected when the target has support for picolibc.

source "Kconfig.zephyr"
```

## firmware/src/boards/maplemini.conf
```kconfig
CONFIG_SERIAL=y
CONFIG_UART_INTERRUPT_DRIVEN=y
# The maplemini does not have enough RAM to enable Zephyr's developer shell.
CONFIG_SHELL=n
CONFIG_SHELL_BACKEND_SERIAL=n
CONFIG_UFW_SHELL_ADDONS=n

# Enable CDC-ACM for USB based serial communication.
CONFIG_HWINFO=y
CONFIG_HWINFO_STM32=y
CONFIG_USB_DC_STM32=y
CONFIG_USB_MAX_POWER=150
CONFIG_USB_DEVICE_DRIVER=y
CONFIG_USB_DEVICE_STACK=y
CONFIG_USB_CDC_ACM=y
CONFIG_USB_COMPOSITE_DEVICE=y
CONFIG_UART_INTERRUPT_DRIVEN=y
CONFIG_USB_DEVICE_VID=0x1234
CONFIG_USB_DEVICE_PID=0xfedc
CONFIG_USB_DEVICE_MANUFACTURER="ChipRemote"
CONFIG_USB_DEVICE_PRODUCT="ChipRemoteBridge"
CONFIG_USB_DEVICE_SN="1122334455667788"

CONFIG_PIPES=y
CONFIG_SPI=y
CONFIG_I2C=y
CONFIG_HWINFO=y
CONFIG_HWINFO_STM32=y

CONFIG_PICOLIBC=y
CONFIG_PICOLIBC_MODULE=y

CONFIG_CR_INTERFACE_SERIAL_FIFO=y
CONFIG_UFW_ENDPOINT_UART_FIFO=y
CONFIG_UFW_ENDPOINT_UART_POLL=y
```

## firmware/src/boards/native_sim_64.conf
```kconfig
# Enable uart0 for a shell into the firmware.
CONFIG_SERIAL=y
CONFIG_UART_NATIVE_POSIX=y
CONFIG_SHELL=y
CONFIG_SHELL_BACKEND_SERIAL=y
CONFIG_UFW_SHELL_ADDONS=y
CONFIG_SHELL_PROMPT_UART="chip-remote% "

# Use picolibc on posix build as well.
CONFIG_PICOLIBC=y
CONFIG_PICOLIBC_MODULE=y

# Default to debugging settings in native posix build.
CONFIG_DEBUG_OPTIMIZATIONS=y
CONFIG_DEBUG=y
CONFIG_ASAN=y
CONFIG_UBSAN=y

CONFIG_CR_INTERFACE_TCPIP=y
CONFIG_INSTRUMENTATION_INTERFACE=y

CONFIG_NETWORKING=y
CONFIG_NET_SOCKETS=y
CONFIG_NET_IPV4=y
CONFIG_NET_IPV6=n
CONFIG_NET_TCP=y
CONFIG_NET_DRIVERS=y
CONFIG_NET_SOCKETS_OFFLOAD=y
CONFIG_NET_NATIVE_OFFLOADED_SOCKETS=y
CONFIG_HEAP_MEM_POOL_SIZE=16384
```

## firmware/src/boards/nucleo_f302r8.conf
```kconfig
CONFIG_SERIAL=y
CONFIG_UART_INTERRUPT_DRIVEN=y

CONFIG_SPI=y
CONFIG_I2C=y
CONFIG_HWINFO=y
CONFIG_HWINFO_STM32=y

CONFIG_PICOLIBC=y
CONFIG_PICOLIBC_MODULE=y

CONFIG_CR_INTERFACE_SERIAL_FIFO=y
CONFIG_UFW_ENDPOINT_UART_FIFO=y
CONFIG_UFW_ENDPOINT_UART_POLL=y
```

## firmware/src/boards/nucleo_f767zi.conf
```kconfig
CONFIG_SERIAL=y
CONFIG_UART_INTERRUPT_DRIVEN=y
CONFIG_SHELL=y
CONFIG_SHELL_BACKEND_SERIAL=y
CONFIG_UFW_SHELL_ADDONS=y
CONFIG_SHELL_PROMPT_UART="chip-remote% "

# Enable CDC-ACM for USB based serial communication.
CONFIG_HWINFO=y
CONFIG_HWINFO_STM32=y
CONFIG_USB_DC_STM32=y
CONFIG_USB_MAX_POWER=150
CONFIG_USB_DEVICE_DRIVER=y
CONFIG_USB_DEVICE_STACK=y
CONFIG_SERIAL=y
CONFIG_USB_CDC_ACM=y
CONFIG_USB_COMPOSITE_DEVICE=y
CONFIG_UART_INTERRUPT_DRIVEN=y
CONFIG_USB_DEVICE_VID=0x1234
CONFIG_USB_DEVICE_PID=0xfedc
CONFIG_USB_DEVICE_MANUFACTURER="ChipRemote"
CONFIG_USB_DEVICE_PRODUCT="ChipRemoteBridge"
CONFIG_USB_DEVICE_SN="1122334455667788"

CONFIG_PICOLIBC=y
CONFIG_PICOLIBC_MODULE=y

CONFIG_SPI=y
CONFIG_I2C=y
CONFIG_CR_INTERFACE_SERIAL_FIFO=y
CONFIG_UFW_ENDPOINT_UART_POLL=y
CONFIG_UFW_ENDPOINT_UART_FIFO=y
```

## firmware/src/boards/nucleo_l476rg.conf
```kconfig
CONFIG_SERIAL=y
CONFIG_UART_INTERRUPT_DRIVEN=y
CONFIG_SHELL=y
CONFIG_SHELL_BACKEND_SERIAL=y
CONFIG_UFW_SHELL_ADDONS=y
CONFIG_SHELL_PROMPT_UART="chip-remote% "

CONFIG_SPI=y
CONFIG_I2C=y
CONFIG_HWINFO=y
CONFIG_HWINFO_STM32=y

CONFIG_PICOLIBC=y
CONFIG_PICOLIBC_MODULE=y

CONFIG_CR_INTERFACE_SIMPLE_SERIAL=y
CONFIG_UFW_ENDPOINT_UART_FIFO=y
CONFIG_UFW_ENDPOINT_UART_POLL=y
```
